/**
* Temporarily switches to a layer (`&mo`) while a modifier is held.
* Analogous to QMK's `LM()`, using a parameterized macro.
*
* Params:
*  1. Layer to switch to
*  2. Modifier to press while layer is active
*
* Example:
*  `&lm NUM_LAYER LSHIFT`
*/
lm: layer_modifier {
  compatible = "zmk,behavior-macro-two-param";
  label = "LAYER_MODIFIER";
  wait-ms = <0>;
  tap-ms = <0>;
  #binding-cells = <2>;
  bindings
       = <&macro_param_1to1>
       , <&macro_press &mo MACRO_PLACEHOLDER>
       , <&macro_param_2to1>
       , <&macro_press &kp MACRO_PLACEHOLDER>
       , <&macro_pause_for_release>
       , <&macro_param_2to1>
       , <&macro_release &kp MACRO_PLACEHOLDER>
       , <&macro_param_1to1>
       , <&macro_release &mo MACRO_PLACEHOLDER>
       ;
};

lm_sticky: layer_modifier_sticky {
  compatible = "zmk,behavior-macro-two-param";
  label = "LAYER_MODIFIER_STICKY";
  wait-ms = <0>;
  tap-ms = <0>;
  #binding-cells = <2>;
  bindings
       = <&macro_param_1to1>
       , <&macro_press &mo MACRO_PLACEHOLDER>
       , <&macro_param_2to1>
       , <&macro_press &sk MACRO_PLACEHOLDER>
       , <&macro_pause_for_release>
       , <&macro_param_2to1>
       , <&macro_release &sk MACRO_PLACEHOLDER>
       , <&macro_param_1to1>
       , <&macro_release &mo MACRO_PLACEHOLDER>
       ;
};


#define STRINGIFY(x) #x

#define DEFINE_HOME_ROW_MOD(NAME, HOLD_BINDING, POSITIONS)    \
    NAME: home_row_mod_##NAME {                               \
      compatible = "zmk,behavior-hold-tap";                   \
      flavor = "balanced";                                    \
      label = STRINGIFY(HOME_ROW_MOD_##NAME);                 \
      #binding-cells = <2>;                                   \
      tapping-term-ms = <500>;                                \
      quick-tap-ms = <200>;                                   \
      require-prior-idle-ms = <50>;                           \
      bindings = <HOLD_BINDING>, <&kp>;                       \
      hold-trigger-key-positions = <POSITIONS>;               \
      hold-trigger-on-release;                                \
    };

#define DEFINE_HOME_ROW_MOD_L(NAME, HOLD_BINDING) DEFINE_HOME_ROW_MOD(NAME, HOLD_BINDING, RIGHT_KEYS THUMB_KEYS)
#define DEFINE_HOME_ROW_MOD_R(NAME, HOLD_BINDING) DEFINE_HOME_ROW_MOD(NAME, HOLD_BINDING, LEFT_KEYS THUMB_KEYS)

// h{mod, layer, globe}{left, right}
DEFINE_HOME_ROW_MOD_L(hml, &kp)
DEFINE_HOME_ROW_MOD_R(hmr, &kp)
DEFINE_HOME_ROW_MOD_L(hll, &mo)
DEFINE_HOME_ROW_MOD_R(hlr, &mo)

// h{layer}{function, media}
DEFINE_HOME_ROW_MOD(hlf, &mo, FN_KEYS)
DEFINE_HOME_ROW_MOD(hlm, &mo, FN_KEYS)

